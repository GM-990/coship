## TestCase/build/share/configuration/Kconfig
```kconfig
#
# COSHIP_MMCP_MACRO configuration
#
comment "Configuration of Dtvmx"
menu "Dtvmx Configuration"
source dtvmx/Kconfig
endmenu

comment "Configuration of GuiTool"
menu "GuiTool Configuration"
source guitool/Kconfig
endmenu

comment "Configuration of JSExt"
menu "JSExt Configuration"
source jsext/Kconfig
endmenu

comment "Configuration of MediaPlayer"
menu "MediaPlayer Configuration"
source mediaplayer/Kconfig
endmenu

comment "Configuration of Shell"
menu "Shell Configuration"
source shell/Kconfig
endmenu

comment "Configuration of Graph"
menu "Graph Configuration"
source graph/Kconfig
endmenu

comment "Configuration of Midp"
menu "Midp Configuration"
source midp/Kconfig
endmenu

comment "Configuration of PROTOCOL"
menu "Protocol Configuration"
source protocol/Kconfig
endmenu

comment "Configuration of KERNEL"
menu "Kernel Configuration"
source kernel/Kconfig
endmenu

comment "Configuration of Public"
menu "Public Configuration"
source public/Kconfig
endmenu

comment "Configuration of Deprecated"
menu "Deprecated Configuration"
source deprecated/Kconfig
endmenu
```

## TestCase/build/share/configuration/deprecated/Kconfig
```kconfig
# Kconfig options for Overdue

##################################################	
config USE_GUITOOL
	bool "MMCP USE GUITOOL"
	default y
	help
		if the system use guitool,
		please select yes ,else select no! 
		
##################################################

			 	  		  	  			 	  				   	  				 	  				  	
```

## TestCase/build/share/configuration/graph/Kconfig
```kconfig
# Kconfig options for Graph


#######################################
# 	Image Decode
########################################	  	

config MMCP_GRAPH_HARDDECODE
	depends MMCP_UDI2
	bool "Graph use Hard decode Image"
	default n
	help
		if the plat support harddecode, bcm7403 use fastjpeg 
		not select,please select yes,else select no! 

config MMCP_GRAPH_USE_FASTJPEG
	bool "Graph use fast decode jpeg Image"
	default n
	help
		this will decode jpeg image fast, can be use in bcm7403 and st7100
		so please select yes on bcm7403 and st7100, other plat please select no!
		
config MEMORY_OPTIMAZATION
	bool "Graph support imagedecode with little memory"
	default n
	help
		if the plat has little memory, you want to show image normally.  
		  please select yes,else select no!
########################################

#######################################
# 	Effect Support
########################################	  	

config MMCP_GRAPH_EFFECT
	bool "Graph Support effect"
	default y
	help
		if the project need effect,
		please select yes,else select no! 
########################################

#######################################
# 	PLAT Support
########################################	  	

config PLAT_NOT_SUPPORT_ZOOM
	depends MMCP_UDI2
	bool "Graph Will ZOOM by Soft"
	default n
	help
		if the plat not support zoom by CSUDIOSGBlit, please select yes,
		such as bcm7580 Standard Display, else select no! 

########################################

#######################################
# 	Input Method Manager Support
########################################	  	

config MMCP_GRAPH_SUPPORT_IMM
	bool "Graph Will support input method manager"
	default n
	help
		if guitools has integration the new input method manager, please select yes,
		else select no!

########################################

#######################################
# 	 FontEngine Select
########################################	  	
choice
	prompt "Selet FontEngine"
	help
	  Selet FontEngine.

config GRAPH_SELECT_FONTENGINE_ARPHIC
	bool "graph use old fontengine"
	help
		if we want use old fontengine, please
		select yes,else select no!	
	
config GRAPH_SELECT_FONTENGINE_ARPHICSTANDARD
	bool "graph use new fontengine"
	help
		if we want use the fontengine witch for guizhou program, please
		select yes,else select no!
		
endchoice

########################################
```

## TestCase/build/share/configuration/guitool/Kconfig
```kconfig
# Kconfig options for GuiTool

	  	
########################################
#        XML module
########################################
config BROWSER_SUPPORT_XML
	bool "Browser Support XML"
	default y
	help
		if browser support XML,please select
	  	yes,else select no!
	  	
config GT_SUPPORT_XML
	depends BROWSER_SUPPORT_XML
	bool "Define GT_SUPPORT_XML"
	default y
	help
		if browser not support XML,the macro
		GT_SUPPORT_XML is invalid!	  	

config GT_SUPPORT_XSLT
	depends BROWSER_SUPPORT_XML
	bool "Define GT_SUPPORT_XSLT"
	default y
	help
		if browser not support XML,the macro
		GT_SUPPORT_XSLT is invalid!

config GT_SUPPORT_XPATH
	depends BROWSER_SUPPORT_XML
	bool "Define GT_SUPPORT_XPATH"
	default y
	help
		if browser not support XML,the macro
		GT_SUPPORT_XPATH is invalid!

########################################
# 	OPENSSL module
########################################	  	
config BROWSER_SUPPORT_OPENSSL
	bool "Browser Support OpenSSL"
	default y
	help
		if browser support OpenSSL,please select
	  	yes,else select no!

config GT_SUPPORT_OPENSSL
	depends BROWSER_SUPPORT_OPENSSL
	bool "Define GT_SUPPORT_OPENSSL"
	default y
	help
		if browser not support OpenSSL,the macro
		GT_SUPPORT_OPENSSL is invalid!

config GT_SUPPORT_SSLEAY
	depends BROWSER_SUPPORT_OPENSSL
	bool "Define GT_SUPPORT_SSLEAY"
	default y
	help
		if browser not support OpenSSL,the macro
		GT_SUPPORT_SSLEAY is invalid!

########################################
# 	Plugin module
########################################	  	
config BROWSER_SUPPORT_PLUGIN
	bool "Browser Support Plugin"
	default y
	help
		if browser support Plugin,please select
	  	yes,else select no!

config GT_SUPPORT_PLUGIN
	depends BROWSER_SUPPORT_PLUGIN
	bool "Define GT_SUPPORT_PLUGIN"
	default y
	help
		if browser not support Plugin,the macro
		GT_SUPPORT_PLUGIN is invalid!	
		
########################################
# 	T9INPUT module
########################################	  	
config BROWSER_SUPPORT_T9INPUT
	bool "Browser Support TPINPUT"
	default y
	help
		if browser support TPINPUT,please select
	  	yes,else select no!

config GT_SUPPORT_T9INPUT
	depends BROWSER_SUPPORT_T9INPUT
	bool "Define GT_SUPPORT_T9INPUT"
	default y
	help
		if browser not support TPINPUT,the macro
		GT_SUPPORT_T9INPUT is invalid!

########################################
# 	VOLMUTEBAR module
########################################	  	
config BROWSER_SUPPORT_VOLMUTEBAR
	bool "Browser Support VolMuteBar"
	default y
	help
		if browser support VolMuteBar,please select
	  	yes,else select no!

config GT_SUPPORT_VOLMUTE
	depends BROWSER_SUPPORT_VOLMUTEBAR
	bool "Define GT_SUPPORT_VOLMUTE"
	default y
	help
		if browser not support VolMuteBar,the macro
		GT_SUPPORT_VOLMUTE is invalid!

########################################
# 	2D module
########################################	  	
config BROWSER_SUPPORT_EFFECT_2D
	bool "Browser Support 2D Effect"
	default y
	help
		if browser support 2D Effect,please select
	  	yes,else select no!

config GT_SUPPORT_EFFECT_2D
	depends BROWSER_SUPPORT_EFFECT_2D
	bool "Define GT_SUPPORT_EFFECT_2D"
	default y
	help
		if browser not support 2D Effect,the macro
		GT_SUPPORT_EFFECT_2D is invalid!

########################################
# 	GTOOL OC
########################################	  	
config BROWSER_SUPPORT_OC
	bool "Browser Support OC"
	default y
	help
		if browser support OC,please select
	  	yes,else select no!

########################################
# 	GTOOL SHTEL
########################################	  	
config BROWSER_SUPPORT_SHTEL
	bool "Browser Support Shtel"
	default n
	help
		if browser support Shtel,please select
	  	yes,else select no!

config GT_SUPPORT_SHTEL
	depends BROWSER_SUPPORT_SHTEL
	bool "Define GT_SUPPORT_SHTEL"
	default y
	help
		if browser not support Shtel,the macro
		GT_SUPPORT_SHTEL is invalid!

########################################
# 	Use Hybrid Memory
########################################		
config usinghybridmem
	bool "Use hybrid Memory"
	default n
	help
		set y to use hybrid memory , make sure 
		the usingtcmalloc is 'y' before  you 
		use this option 

config GT_SUPPORT_CSMALLOC
	depends usinghybridmem
	bool "Define GT_SUPPORT_CSMALLOC"
	default y
	help
		if not use hybridmem,the macro
		GT_SUPPORT_CSMALLOC is invalid!

########################################
# 	hybridpoolsize
########################################
config hybridpoolsize
	string "Set Hybridpoolsize"
	default "default"
	help
		memory pool size in hybrid memory situation, 
		if you set the value ,please make sure the size 
		lager than 3M ,else don't change

config HYBRID_POOLSIZE
	depends hybridpoolsize != "default"
	string "Define HYBRID_POOLSIZE"
	default "$(hybridpoolsize)"
	help
		if hybridpoolsize equal to "default",the macro
		HYBRID_POOLSIZE is invalid

########################################
# 	maxconnectcount
########################################
config maxconnectcount
	string "Set Maxconnectcount"
	default "default"
	help
		max sokect connect at one time , 
		default value is 5 

config MAX_CONNECTCOUNT
	depends maxconnectcount != "default"
	string "Define MAX_CONNECTCOUNT"
	default "$(maxconnectcount)"
	help
		if maxconnectcount equal to "default",the macro
		MAX_CONNECTCOUNT is invalid
		
########################################
# 	colorbits
########################################
config colorbits
	string "Set Colorbits"
	default "default"
	help
		set color bit ,you can set it to  32 or 16

config COLOR_BITS
	depends colorbits != "default"
	string "Define COLOR_BITS"
	default "$(colorbits)"
	help
		if colorbits equal to "default",the macro
		COLOR_BITS is invalid

########################################
# 	imagemaxmemory
########################################
config imagemaxmemory
	string "Set imagemaxmemory"
	default "default"
	help
		set cache image MAX memeory size

config IMAGEMAXMEM
	depends imagemaxmemory != "default"
	string "Define IMAGEMAXMEM"
	default "$(imagemaxmemory)"
	help
		if imagemaxmemory equal to "default",the macro
		IMAGEMAXMEM is invalid
  		  			  			  	
```

## TestCase/build/share/configuration/jsext/Kconfig
```kconfig
# Kconfig options for JSExt

###################################################	  	
config MMCP_JSEXT_SUPPORT_DVB
	bool "Jsext support dvb"
	default y
	help
		if jsext support dvb,please
		select yes,else select no!
###################################################	 	

###################################################	  	
config SUPPORT_PROJECT_TJBANK
	bool "SUPPORT_PROJECT_TJBANK"
	default n
	help
		if jsext support TJBank,please
		select yes,else select no!
###################################################

###################################################	  	
config MMCP_JSEXT_SUPPORT_COSHIP
	bool "Jsext support coship"
	default y
	help
		if jsext support coship,please
		select yes,else select no!
###################################################	

###################################################	  	
config MMCP_JSEXT_SUPPORT_ENREACH
	bool "Jsext support enreach"
	default n
	help
		if jsext support enreach,please
		select yes,else select no!
###################################################	

###################################################	  	
config MMCP_JSEXT_SUPPORT_VOD_DMX
	bool "Jsext support vod dmx"
	default n
	help
		if jsext support vod dmx,please
		select yes,else select no!
###################################################	

###################################################	  	
config MMCP_JSEXT_SUPPORT_VOD_MOTO
	bool "Jsext support vod moto"
	default n
	help
		if jsext support vod moto,please
		select yes,else select no!
###################################################	

###################################################	  	
config MMCP_JSEXT_SUPPORT_VOD_CITV
	bool "Jsext support vod citv"
	default n
	help
		if jsext support vod citv,please
		select yes,else select no!
###################################################		

###################################################	  	
config MMCP_JSEXT_SUPPORT_PROJECT_TOPWAY
	bool "Jsext support topway"
	default n
	help
		if jsext support topway,please
		select yes,else select no!
###################################################	

###################################################	  	
config MMCP_JSEXT_SUPPORT_PROJECT_IPTV1
	bool "Jsext support IPTV1"
	default n
	help
		if jsext support IPTV1,please
		select yes,else select no!
###################################################

###################################################	  	
config MMCP_JSEXT_SUPPORT_PROJECT_IPTV2
	bool "Jsext support IPTV2"
	default n
	help
		if jsext support IPTV2,please
		select yes,else select no!
###################################################

###################################################	  	
config MMCP_JSEXT_SUPPORT_UPNP
	bool "Jsext support upnp"
	default n
	help
		if jsext support upnp,please
		select yes,else select no!
###################################################		
	  		  	  		  	  			 	  				   	  				 	  				  	
```

## TestCase/build/share/configuration/kernel/Kconfig
```kconfig
# Kconfig options for Kernel

###################################################	  	
config MMCP_LOCKCHECK_SUPPORT
	bool "Debug With LockCheck"
	default n
	help
		if need debug with lockcheck,please
		select yes,else select no!
	  	
config MMCP_KERNEL_MEMORY_DLMALLOC
	bool "Support dlmalloc memory Management "
	default n
	help
		if support dlmalloc memory Management ,
		please select yes,else select no!
###################################################	

		
		
			 	  		  	  			 	  				   	  				 	  				  	
```

## TestCase/build/share/configuration/mediaplayer/Kconfig
```kconfig
# Kconfig options for MediaPlayer

###################################################	  	
config CITV_IPQAM
	bool "Define CITV_IPQAM"
	default y
	help
		if need define CITV_IPQAM,please select
	  	yes,else select no!

##################################################					  		
###       select plugin for mediaplayer        ###
##################################################	  	
choice
	prompt "Selet Plugin for Mediaplayer"
	help
	  Selet Plugin for Mediaplayer.

config MP_ACCESS_PLUGIN_CITV_MAP
	bool "MP access plugin citv_map"
	help
		if MP access plugin citv_map, please
		select yes,else select no!	
	
config MP_ACCESS_PLUGIN_CITV
	bool "MP access plugin citv"
	help
		if MP access plugin citv, please
		select yes,else select no!

config MP_ACCESS_PLUGIN_SHTEL
	bool "MP access plugin shtel"
	help
		if MP access plugin shtel, please
		select yes,else select no!

config MP_ACCESS_PLUGIN_SHTEL20
	bool "MP access plugin shtel2.0"
	help
		if MP access plugin shtel2.0, please
		select yes,else select no!
	
config MP_ACCESS_PLUGIN_HW
	bool "MP access plugin huawei vod"
	help
		if MP access plugin huawei vod, please
		select yes,else select no!	

config MP_ACCESS_PLUGIN_SCTEL
	bool "MP access plugin sicuantel vod"
	help
		if MP access plugin sicuantel vod, please
		select yes,else select no!			
		
config MP_ACCESS_PLUGIN_SEACHANGE
	bool "MP access plugin seachange vod"
	help
		if MP access plugin seachange vod, please
		select yes,else select no!			
				
config MP_ACCESS_PLUGIN_NGOD
	bool "MP access plugin NGOD vod"
	help
		if MP access plugin NGOD vod, please
		select yes,else select no!

endchoice
		
##################################################

	  	  		  	  			 	  				   	  				 	  				  	
```

## TestCase/build/share/configuration/midp/Kconfig
```kconfig
# Kconfig options for Midp


#######################################
# 	Fileconnection
########################################	  	

config MMCP_MIDP_SUPPORT_FILECONNECTION
	bool "Midp Support Fileconnection"
	default y
	help
		if Midp support fileconnection,
		please select yes,else select no! 		
########################################
```
